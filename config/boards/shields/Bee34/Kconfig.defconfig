## config/boards/shields/Bee34/Kconfig.defconfig
```kconfig
# Copyright (c) 2021 The ZMK Contributors
# SPDX-License-Identifier: MIT

if SHIELD_BEE34_LEFT

config ZMK_KEYBOARD_NAME
    default "Bee34"

config ZMK_SPLIT_ROLE_CENTRAL
    default y

endif

if SHIELD_BEE34_LEFT || SHIELD_BEE34_RIGHT

config ZMK_SPLIT
    default y

config ZMK_RGB_UNDERGLOW
    select WS2812_STRIP
    select SPI

endif
```

## config/boards/shields/Bee34/Kconfig.shield
```kconfig
# Copyright (c) 2021 The ZMK Contributors
# SPDX-License-Identifier: MIT

config SHIELD_BEE34_LEFT
    def_bool $(shields_list_contains,Bee34_left)

config SHIELD_BEE34_RIGHT
    def_bool $(shields_list_contains,Bee34_right)
```

## config/boards/shields/crap32/Kconfig.defconfig
```kconfig
# Copyright (c) 2021 The ZMK Contributors
# SPDX-License-Identifier: MIT

if SHIELD_CRAP32_LEFT

config ZMK_KEYBOARD_NAME
    default "crap32"

config ZMK_SPLIT_ROLE_CENTRAL
    default y

endif

if SHIELD_CRAP32_LEFT || SHIELD_CRAP32_RIGHT

config ZMK_SPLIT
    default y

config ZMK_RGB_UNDERGLOW
    select WS2812_STRIP
    select SPI
    default y

endif
```

## config/boards/shields/crap32/Kconfig.shield
```kconfig
# Copyright (c) 2021 The ZMK Contributors
# SPDX-License-Identifier: MIT

config SHIELD_CRAP32_LEFT
    def_bool $(shields_list_contains,crap32_left)

config SHIELD_CRAP32_RIGHT
    def_bool $(shields_list_contains,crap32_right)
```

## config/boards/shields/flap32/Kconfig.shield
```kconfig
# Copyright (c) 2021 The ZMK Contributors
# SPDX-License-Identifier: MIT

config SHIELD_FLAP32_LEFT
    def_bool $(shields_list_contains, Flap32_left)

config SHIELD_FLAP32_RIGHT
    def_bool $(shields_list_contains, Flap32_right)
```
